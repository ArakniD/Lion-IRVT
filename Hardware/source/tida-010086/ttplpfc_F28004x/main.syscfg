/**
 * @cliArgs --device "F28004x" --package "F28004x_100PZ" --part "F28004x_100PZ" --product "powerSUITE@3.00.00.00"
 * @versions {"data":"2021010520","timestamp":"2021010520","tool":"1.7.0+1746","templates":null}
 */

/**
 * Import the modules used in this configuration.
 */
const TIDM_02008 = scripting.addModule("/devkits/TIDM_02008/TIDM_02008");

/**
 * Write custom configuration values to the imported modules.
 */
TIDM_02008.Fsw             = 100;
TIDM_02008.Min_PFCDeadband = 0.1;
TIDM_02008.Max_PFCDeadband = 0.1;
TIDM_02008.Vout            = 380;
TIDM_02008.Vin             = 120;
TIDM_02008.P_Rated         = 3300;
TIDM_02008.Pout            = 768;
TIDM_02008.Li              = 0.481;
TIDM_02008.Ri              = 0.057;
TIDM_02008.Cf              = 880;
TIDM_02008.Rcf             = 0.365;
TIDM_02008.Vout_SenseMax   = 462.66;
TIDM_02008.Vin_SenseMax    = 462.66;
TIDM_02008.I_SenseMax      = 24.778;
TIDM_02008.I_TripLevel     = 24;
TIDM_02008.Rfltr           = 47;
TIDM_02008.Cfltr           = 0.047;
TIDM_02008.SFRA_Type       = 1;
TIDM_02008.Non_linear_loop = 1;
TIDM_02008.LAB_Index       = 1;
